## arch/arm64/Kconfig
```kconfig
# SPDX-License-Identifier: GPL-2.0
# Select 32 or 64 bit

menu "architecture and General options"

config ARM64
	def_bool y

config ARM
	def_bool y

config ARM64
	def_bool y

config PHYS_64BIT
	def_bool y

config DMA_ADDR_T_64BIT
	def_bool y

config CPU_BIG_ENDIAN
	bool "Enable Big Endian Mode"
    default n

config HAVE_STACKPROTECTOR
	bool "Enable HAVE_STACKPROTECTOR"
    default n

endmenu
```

## arch/arm64/Kconfig.addr
```kconfig
# SPDX-License-Identifier: GPL-2.0

config SYS_TEXT_BASE
	hex "Text Base"
	default 0x02000000
	help
	  The address in memory that vmimage will be running from, initially.

config RELOC_SYS_TEXT_BASE
	default 0x80000000
	hex "Reloc sys text base"

config RELOC_SYS_BLOCK_SIZE
	default 0x80000000
	hex "Reloc sys block size"
```

## cmd/Kconfig
```kconfig
# SPDX-License-Identifier: GPL-2.0

menu "Command line interface"

if CMDLINE

config DEBUG_CMD
    bool "Debug command"
    default n
endif

config CMD_UART
    bool "uart"
    default y
    select UART_TEST
    help
        Initialize uart module,	set baud rate, send and
        receive data.

config CMD_GICV3
    bool "gic v3"
    depends on GICV3_TEST
    help
        gic v3 support

config CMD_MEMORY
	bool "md, mw, cp, cmp, base"
	default y
	help
	  Memory commands.
	    md - memory display
	    mw - memory write (fill)
	    cp - memory copy
	    cmp - memory compare
	    base - print or set address offset

endmenu
```

## common/Kconfig
```kconfig
# SPDX-License-Identifier: GPL-2.0

menu "Common Features"

config CMDLINE
	bool "Support commands base on U-Boot"
	default y
	help
	  Enable U-Boot's command-line functions. This provides a means
	  to enter commands into U-Boot for a wide variety of purposes. It
	  also allows scripts (containing commands) to be executed.
	  Various commands and command categorys can be indivdually enabled.
	  Depending on the number of commands enabled, this can add
	  substantially to the size of U-Boot.

config CMDLINE_EDITING
	bool "Enable command line editing"
	depends on CMDLINE
	default y
	help
	  Enable editing and History functions for interactive command line
	  input operations

config AUTO_COMPLETE
	bool "Enable auto complete using TAB"
	depends on CMDLINE
	default y
	help
	  Enable auto completion of commands using TAB.

config SYS_LONGHELP
	bool "Enable long help messages"
	depends on CMDLINE
	default y if CMDLINE
	help
	  Defined when you want long help messages included
	  Do not set this option when short of memory.

config SYS_PROMPT
	string "Shell prompt"
	depends on CMDLINE
	default "[rock]# " if arm64
	default "# "
	help
	  This string is displayed in the command line to the left of the
	  cursor.
config IDENT_STRING
	string
	default "ROCK5A" if ROCK5A
	
config DEBUG_CLI
	bool "Debug command line interface"
	default n

endmenu
```

## configs/rock_defconfig
```kconfig
CONFIG_ARM64=y
CONFIG_ROCK5A=y
CONFIG_CC_HAS_STACKPROTECTOR_NONE=y
CONFIG_HELLO_WORLD=y
CONFIG_CMDLINE=y
CONFIG_PRINTF=y
CONFIG_PLUGIN_HOSTCC=""
CONFIG_LOCALVERSION=""
CONFIG_LOCALVERSION_AUTO=y
CONFIG_CC_OPTIMIZE_FOR_PERFORMANCE=y
CONFIG_PROJECT="ROCK5A"
CONFIG_S_PROJECT="rock"
CONFIG_SYS_TEXT_BASE=0x02000000
CONFIG_RELOC_SYS_TEXT_BASE=0x02000000
CONFIG_RELOC_SYS_BLOCK_SIZE=0x20000000
CONFIG_UART_MAX_NUM=10
CONFIG_PRINT_UART_BAUD=1500000
CONFIG_UART_PORT=2

CONFIG_UART_TEST=y
CONFIG_ERRNO_STR=y
CONFIG_SYS_PBSIZE=1024
CONFIG_MESSAGE_LOGLEVEL_DEFAULT=7
CONFIG_AUTO_COMPLETE=y
CONFIG_SYS_LONGHELP=y
CONFIG_SYS_PROMPT="[rock]# "
CONFIG_IDENT_STRING="ROCK5A"
CONFIG_CMD_UART=y

CONFIG_CMD_GICV3=y
CONFIG_GICV3_ITS=y
CONFIG_GICV3_TEST=y
```

## init/Kconfig
```kconfig
# SPDX-License-Identifier: GPL-2.0

config DEFCONFIG_LIST
	string
	depends on !UML
	option defconfig_list
	default ARCH_DEFCONFIG
	default "arch/$(ARCH)/defconfig"

config CC_IS_GCC
	def_bool $(success,$(CC) --version | head -n 1 | grep -q gcc)

config GCC_VERSION
	int
	default $(shell,$(srctree)/scripts/gcc-version.sh -p $(CC) | sed 's/^0*//') if CC_IS_GCC
	default 0


menu "General setup"

config LOCALVERSION
	string "Local version - append to vmimage release"
	help
	  Append an extra string to the end of your vmimage version.
	  This will show up when you type uname, for example.
	  The string you set here will be appended after the contents of
	  any files with a filename matching localversion* in your
	  object and source tree, in that order.  Your total string can
	  be a maximum of 64 characters.

config LOCALVERSION_AUTO
	bool "Automatically append version information to the version string"
	default y
	depends on !COMPILE_TEST
	help
	  This will try to automatically determine if the current tree is a
	  release tree by looking for git tags that belong to the current
	  top of tree revision.

	  A string of the format -gxxxxxxxx will be added to the localversion
	  if a git-based tree is found.  The string generated by this will be
	  appended after any matching localversion* files, and after the value
	  set in CONFIG_LOCALVERSION.

	  (The actual string used here is the first eight characters produced
	  by running the command:

	    $ git rev-parse --verify HEAD

	  which is done within the script "scripts/setlocalversion".)

choice
	prompt "Compiler optimization level"
	default CC_OPTIMIZE_FOR_PERFORMANCE

config CC_OPTIMIZE_FOR_PERFORMANCE
	bool "Optimize for performance"
	help
	  This is the default optimization level for the vmimage, building
	  with the "-O2" compiler flag for best performance and most
	  helpful compile-time warnings.

config CC_OPTIMIZE_FOR_SIZE
	bool "Optimize for size"
	help
	  Enabling this option will pass "-Os" instead of "-O2" to
	  your compiler resulting in a smaller vmimage.

	  If unsure, say N.

endchoice

endmenu

menu "Platform selection"
config PROJECT
	string
	default "ROCK5A" if ROCK5A

config S_PROJECT
	string
	default "rock" if ROCK5A


choice
	prompt "Hareware platform select"
	default ROCK5A

config ROCK5A
	bool "rock5a Hardware"

endchoice
source "arch/$(SRCARCH)/Kconfig.addr"
endmenu

source "arch/Kconfig"
```

## lib/Kconfig
```kconfig
# SPDX-License-Identifier: GPL-2.0

menu "Library options"

config ERRNO_STR
	bool "Enable function for getting errno-related string message"
	help
	  The function errno_str(int errno), returns a pointer to the errno
	  corresponding text message:
	  - if errno is null or positive number - a pointer to "Success" message
	  - if errno is negative - a pointer to errno related message

config SYS_PBSIZE
	int "Print message string buffer size"
	default 4096

endmenu
```

## lib/Kconfig.debug
```kconfig
# SPDX-License-Identifier: GPL-2.0

menu "rock hacking"

menu "print and message options"

config MESSAGE_LOGLEVEL_DEFAULT
	int "Default message log level (1-7)"
	range 1 7
	default "4"
	help
	  Default log level for printk statements with no specified priority.

	  This was hard-coded to KERN_WARNING since at least 2.6.10 but folks
	  that are auditing their logs closely may want to set it to a lower
	  priority.

	  Note: This does not affect what message level gets printed on the console
	  by default. To change that, use loglevel=<x> in the vmimage bootargs,
	  or pick a different CONSOLE_LOGLEVEL_DEFAULT configuration value.

endmenu     # print and message options

menu "Compile-time checks and compiler options"

config DEBUG_INFO
	bool "Compile the vmimage with debug info"
	depends on DEBUG_ROCK && !COMPILE_TEST
	help
          If you say Y here the resulting vmimage image will include
	  debugging info resulting in a larger vmimage image.
	  This adds debug symbols to the vmimage and modules (gcc -g), and
	  is needed if you intend to use vmimage crashdump or binary object
	  tools like crash, kgdb, LKCD, gdb, etc on the vmimage.
	  Say Y here only if you plan to debug the vmimage.

	  If unsure, say N.

config DEBUG_INFO_REDUCED
	bool "Reduce debugging information"
	depends on DEBUG_INFO
	help
	  If you say Y here gcc is instructed to generate less debugging
	  information for structure types. This means that tools that
	  need full debugging information (like kgdb or systemtap) won't
	  be happy. But if you merely need debugging information to
	  resolve line numbers there is no loss. Advantage is that
	  build directory object sizes shrink dramatically over a full
	  DEBUG_INFO build and compile times are reduced too.
	  Only works with newer gcc versions.

config DEBUG_INFO_SPLIT
	bool "Produce split debuginfo in .dwo files"
	depends on DEBUG_INFO
	help
	  Generate debug info into separate .dwo files. This significantly
	  reduces the build directory size for builds with DEBUG_INFO,
	  because it stores the information only once on disk in .dwo
	  files instead of multiple times in object files and executables.
	  In addition the debug information is also compressed.

	  Requires recent gcc (4.7+) and recent gdb/binutils.
	  Any tool that packages or reads debug information would need
	  to know about the .dwo files and include them.
	  Incompatible with older versions of ccache.

config DEBUG_INFO_DWARF4
	bool "Generate dwarf4 debuginfo"
	depends on DEBUG_INFO
	help
	  Generate dwarf4 debug info. This requires recent versions
	  of gcc and gdb. It makes the debug information larger.
	  But it significantly improves the success of resolving
	  variables in gdb on optimized code.

config ENABLE_MUST_CHECK
	bool "Enable __must_check logic"
	default y
	help
	  Enable the __must_check logic in the kernel build.  Disable this to
	  suppress the "warning: ignoring return value of 'foo', declared with
	  attribute warn_unused_result" messages.

config FRAME_WARN
	int "Warn for stack frames larger than (needs gcc 4.4)"
	range 0 8192
	default 3072 if KASAN_EXTRA
	default 2048 if GCC_PLUGIN_LATENT_ENTROPY
	default 1280 if (!64BIT && PARISC)
	default 1024 if (!64BIT && !PARISC)
	default 2048 if 64BIT
	help
	  Tell gcc to warn at build time for stack frames larger than this.
	  Setting this too low will cause a lot of warnings.
	  Setting it to 0 disables the warning.
	  Requires gcc 4.4

config STRIP_ASM_SYMS
	bool "Strip assembler-generated symbols during link"
	default n
	help
	  Strip internal assembler-generated symbols during a link (symbols
	  that look like '.Lxxx') so they don't pollute the output of
	  get_wchan() and suchlike.

config READABLE_ASM
        bool "Generate readable assembler code"
        depends on DEBUG_ROCK
        help
          Disable some compiler optimizations that tend to generate human unreadable
          assembler output. This may make the vmimage slightly slower, but it helps
          to keep vmimage developers who have to stare a lot at assembler listings
          sane.

config DEBUG_SECTION_MISMATCH
	bool "Enable full Section mismatch analysis"
	help
	  The section mismatch analysis checks if there are illegal
	  references from one section to another section.
	  During linktime or runtime, some sections are dropped;
	  any use of code/data previously in these sections would
	  most likely result in an oops.
	  In the code, functions and variables are annotated with
	  __init,, etc. (see the full list in include/linux/init.h),
	  which results in the code/data being placed in specific sections.
	  The section mismatch analysis is always performed after a full
	  vmimage build, and enabling this option causes the following
	  additional steps to occur:
	  - Add the option -fno-inline-functions-called-once to gcc commands.
	    When inlining a function annotated with __init in a non-init
	    function, we would lose the section information and thus
	    the analysis would not catch the illegal reference.
	    This option tells gcc to inline less (but it does result in
	    a larger vmimage).
	  - Run the section mismatch analysis for each module/built-in.a file.
	    When we run the section mismatch analysis on vmlinux.o, we
	    lose valuable information about where the mismatch was
	    introduced.
	    Running the analysis for each module/built-in.a file
	    tells where the mismatch happens much closer to the
	    source. The drawback is that the same mismatch is
	    reported at least twice.
	  - Enable verbose reporting from modpost in order to help resolve
	    the section mismatches that are reported.

config ARCH_WANT_FRAME_POINTERS
	bool

config FRAME_POINTER
	bool "Compile the vmimage with frame pointers"
	depends on DEBUG_ROCK && (M68K || UML || SUPERH) || ARCH_WANT_FRAME_POINTERS
	default y if (DEBUG_INFO && UML) || ARCH_WANT_FRAME_POINTERS
	help
	  If you say Y here the resulting vmimage image will be slightly
	  larger and slower, but it gives very useful debugging information
	  in case of vmimage bugs. (precise oopses/stacktraces/warnings)


endmenu # "Compiler options"

config DEBUG_ROCK
	bool "vmimage debugging"
	help
	  Say Y here if you are developing drivers or trying to debug and
	  identify vmimage problems.

source "arch/$(SRCARCH)/Kconfig.debug"

endmenu
```

## module/Kconfig
```kconfig
# SPDX-License-Identifier: GPL-2.0

menu "Module driver"
	config HELLO_WORLD
		bool "hello world"

	config UART_TEST
		bool "Open UART test"
	if UART_TEST
	source "module/uart/Kconfig"
	endif

	config GICV3_TEST
	bool "Open Module GICV3 test"
	default y
	if GICV3_TEST
	source "module/gicv3/Kconfig"
	endif

endmenu
```

## module/gicv3/Kconfig
```kconfig
# SPDX-License-Identifier: GPL-2.0

menu "GIC V3 controler options"

config DEBUG_GICV3
    bool "Debug gic v3 controler driver"
    default n

config GICV3_ITS
	bool "gic v3 its test"
	default y

endmenu
```

## module/uart/Kconfig
```kconfig
# SPDX-License-Identifier: GPL-2.0

menu "UART options"

config DEBUG_UART
    bool "Debug uart module"
    default n

config UART_MAX_NUM
    int
    default 4

config PRINT_UART_BAUD
	int "print uart rate option"
	default 115200

config UART_PORT
	int "UART [0-3] is output as a serial port"
	default 0

endmenu
```
